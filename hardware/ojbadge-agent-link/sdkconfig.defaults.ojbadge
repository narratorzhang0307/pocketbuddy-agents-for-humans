## hardware/ojbadge-agent-link/sdkconfig.defaults.ojbadge
```kconfig
CONFIG_BOARD_TYPE_ESP32S3_OJBADGE=y
CONFIG_AGENT_LINK_TRANSPORT_BLE=y
CONFIG_ESP_CONSOLE_USB_SERIAL_JTAG=y
CONFIG_ESPTOOLPY_FLASHSIZE_16MB=y
CONFIG_SPIRAM=y
CONFIG_SPIRAM_MODE_OCT=y
CONFIG_SPIRAM_SPEED_80M=y
CONFIG_SPIRAM_IGNORE_NOTFOUND=n
CONFIG_RTC_CLK_SRC_INT_RC=y
CONFIG_LV_CONF_SKIP=y
CONFIG_LV_COLOR_DEPTH_16=y
CONFIG_LV_COLOR_16_SWAP=y
CONFIG_LV_MEM_SIZE_KILOBYTES=64
```
